## components/apps/Kconfig.projbuild
```kconfig
menu "Video Configuration"

    config EXAMPLE_ENABLE_MIPI_CSI_CAM_SENSOR
        bool "Enable MIPI CSI Camera Sensor"
        default y
        depends on SOC_MIPI_CSI_SUPPORTED

    if EXAMPLE_ENABLE_MIPI_CSI_CAM_SENSOR
        config EXAMPLE_MIPI_CSI_SCCB_I2C_PORT
            int "MIPI CSI SCCB I2C Port Number"
            default 0
            range 0 1

        config EXAMPLE_MIPI_CSI_SCCB_I2C_SCL_PIN
            int "MIPI CSI SCCB I2C SCL Pin"
            default 8
            range -1 56

        config EXAMPLE_MIPI_CSI_SCCB_I2C_SDA_PIN
            int "MIPI CSI SCCB I2C SDA Pin"
            default 7
            range -1 56

        config EXAMPLE_MIPI_CSI_SCCB_I2C_FREQ
            int "MIPI CSI SCCB I2C Frequency"
            default 100000
            range 100000 400000
            help
                Increasing this value can reduce the initialization time of the camera sensor.
                Please refer to the relevant instructions of the camera sensor to adjust the value.

        config EXAMPLE_MIPI_CSI_CAM_SENSOR_RESET_PIN
            int "MIPI CSI Camera Sensor Reset Pin"
            default -1
            range -1 56

        config EXAMPLE_MIPI_CSI_CAM_SENSOR_PWDN_PIN
            int "MIPI CSI Camera Sensor Power Down Pin"
            default -1
            range -1 56
    endif

    config EXAMPLE_ENABLE_PRINT_FPS_RATE_VALUE
        bool "enable print fps rate value"
        default y

    config EXAMPLE_ENABLE_CAM_SENSOR_PIC_VFLIP
        bool "Enable Camera Sensor Picture Vertical Flip"
        default y
        help
            Select this option, enable camera sensor picture vertical flip.

    config EXAMPLE_ENABLE_CAM_SENSOR_PIC_HFLIP
        bool "Enable Camera Sensor Picture Horizontal Flip"
        default y
        help
            Select this option, enable camera sensor picture horizontal flip.

endmenu

menu "HCC RFFE"

    config HCC_RFFE_SCLK_GPIO
        int "RFFE SCLK GPIO (-1 = not connected)"
        default 2
        range -1 54
        help
            GPIO driving MIPI RFFE SCLK. RFFE is a 1.8 V bus: use a level shifter.

    config HCC_RFFE_SDATA_GPIO
        int "RFFE SDATA GPIO (-1 = not connected)"
        default 3
        range -1 54
        help
            GPIO for bidirectional MIPI RFFE SDATA (1.8 V bus, needs a bidirectional level shifter).

    config HCC_RFFE_HALF_PERIOD_US
        int "RFFE SCLK half period (us)"
        default 5
        range 1 100
        help
            Bit-bang half period. 5 us gives about 100 kHz SCLK.

endmenu

menu "HCC LOGIC ANALYZER"

    # 8 kênh vào của LOGIC ANALYZER (PARLIO RX 8 bit). Chỉ nhận tín hiệu 0 / 3,3 V: tín hiệu 1,2 / 1,8 V cần
    # mạch chuyển mức một chiều. Firmware từ chối chân của LCD, thẻ SD, âm thanh, I2C cảm ứng, SDIO Wi-Fi, USB.
    config HCC_LOGIC_CH0_GPIO
        int "D0 GPIO (-1 = không dùng)"
        default 20
        range -1 54
    config HCC_LOGIC_CH1_GPIO
        int "D1 GPIO"
        default 21
        range -1 54
    config HCC_LOGIC_CH2_GPIO
        int "D2 GPIO"
        default 22
        range -1 54
    config HCC_LOGIC_CH3_GPIO
        int "D3 GPIO"
        default 23
        range -1 54
    config HCC_LOGIC_CH4_GPIO
        int "D4 GPIO"
        default 26
        range -1 54
    config HCC_LOGIC_CH5_GPIO
        int "D5 GPIO"
        default 27
        range -1 54
    config HCC_LOGIC_CH6_GPIO
        int "D6 GPIO"
        default 47
        range -1 54
    config HCC_LOGIC_CH7_GPIO
        int "D7 GPIO"
        default 48
        range -1 54

endmenu
```
